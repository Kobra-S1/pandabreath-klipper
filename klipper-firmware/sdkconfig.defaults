## klipper-firmware/sdkconfig.defaults
```kconfig
# ESP32-C3 target
CONFIG_IDF_TARGET="esp32c3"

# FreeRTOS tick rate required by Klipper
CONFIG_FREERTOS_HZ=1000

# Main task stack
CONFIG_ESP_MAIN_TASK_STACK_SIZE=8192

# Force UART console (CH340K bridge) — override the ESP32-C3 default of USB CDC
CONFIG_KLIPPER_CONSOLE_UART=y

# UART0: TX=GPIO21 (TXD0), RX=GPIO20 (RXD0) — wired to CH340K on the Panda Breath PCB
# These are the default UART0 pins on the ESP32-C3-MINI-1 module (physical pins 30/31)
CONFIG_KLIPPER_UART_NUM=0
CONFIG_KLIPPER_UART_TX_PIN=21
CONFIG_KLIPPER_UART_RX_PIN=20
CONFIG_KLIPPER_UART_RTS_PIN=-1
CONFIG_KLIPPER_UART_CTS_PIN=-1
CONFIG_KLIPPER_UART_BAUD_RATE=250000
CONFIG_KLIPPER_UART_TX_BUFFER_SIZE=256
CONFIG_KLIPPER_UART_RX_BUFFER_SIZE=1024
CONFIG_KLIPPER_CONSOLE_RX_BUFFER_SIZE=4096
```
